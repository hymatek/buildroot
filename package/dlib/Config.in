## package/dlib/Config.in
```kconfig
config BR2_PACKAGE_DLIB
	bool "dlib"
	depends on BR2_INSTALL_LIBSTDCPP
	depends on BR2_TOOLCHAIN_HAS_THREADS
	help
	  Dlib is a modern C++ toolkit containing machine learning
	  algorithms and tools for creating complex software in C++ to
	  solve real world problems.

	  http://dlib.net

if BR2_PACKAGE_DLIB

config BR2_PACKAGE_DLIB_GIF_SUPPORT
	bool "GIF support"
	select BR2_PACKAGE_GIFLIB

config BR2_PACKAGE_DLIB_GUI_SUPPORT
	bool "GUI support"
	depends on BR2_PACKAGE_XORG7
	select BR2_PACKAGE_XLIB_LIBX11

config BR2_PACKAGE_DLIB_JPEG_SUPPORT
	bool "JPEG support"
	select BR2_PACKAGE_JPEG

config BR2_PACKAGE_DLIB_JXL_SUPPORT
	bool "JXL support"
	select BR2_PACKAGE_LIBJXL

config BR2_PACKAGE_DLIB_PNG_SUPPORT
	bool "PNG support"
	select BR2_PACKAGE_LIBPNG

config BR2_PACKAGE_DLIB_USE_BLAS
	bool "use openblas"
	depends on BR2_PACKAGE_OPENBLAS_ARCH_SUPPORTS
	select BR2_PACKAGE_OPENBLAS

config BR2_PACKAGE_DLIB_USE_FFMPEG
	bool "use ffmpeg"
	depends on BR2_PACKAGE_FFMPEG_ARCH_SUPPORTS
	select BR2_PACKAGE_FFMPEG
	select BR2_PACKAGE_FFMPEG_SWSCALE

config BR2_PACKAGE_DLIB_USE_LAPACK
	bool "use lapack"
	depends on BR2_PACKAGE_LAPACK_ARCH_SUPPORTS
	depends on BR2_TOOLCHAIN_HAS_FORTRAN
	select BR2_PACKAGE_LAPACK

config BR2_PACKAGE_DLIB_WEBP_SUPPORT
	bool "WEBP support"
	select BR2_PACKAGE_WEBP

endif

comment "dlib needs a toolchain w/ C++, threads"
	depends on !BR2_INSTALL_LIBSTDCPP || \
		!BR2_TOOLCHAIN_HAS_THREADS
```

## package/qt6/qt6base/Config.in.host
```kconfig
config BR2_PACKAGE_HOST_QT6BASE
	bool "host qt6base"
	help
	  Qt is a cross-platform application and UI framework for
	  developers using C++.

	  This package corresponds to the qt6base module, which
	  contains the base Qt libraries: QtCore, QtNetwork, QtGui,
	  QtWidgets, etc.

	  http://qt.io

if BR2_PACKAGE_HOST_QT6BASE

config BR2_PACKAGE_HOST_QT6BASE_GUI
	bool "gui module"
	help
	  This option enables the Qt6Gui library.

config BR2_PACKAGE_HOST_QT6BASE_NETWORK
	bool "network module"
	help
	  This options enables the Qt6Network library.

endif
```

## package/qt6/qt6declarative/Config.in.host
```kconfig
config BR2_PACKAGE_HOST_QT6DECLARATIVE
	bool "host qt6declarative"
	help
	  Qt is a cross-platform application and UI framework for
	  developers using C++.

	  This package corresponds to the qt6declarative module.

	  https://doc.qt.io/qt-6/qtdeclarative-index.html
```

## package/qt6/qt6languageserver/Config.in
```kconfig
config BR2_PACKAGE_QT6LANGUAGESERVER
	bool "qt6languageserver"
	help
	  Qt is a cross-platform application and UI framework for
	  developers using C++.

	  This package corresponds to the qt6serialbus module.

	  https://doc.qt.io/qt-6/qtlanguageserver-index.html
```

## package/qt6/qt6mqtt/Config.in
```kconfig
config BR2_PACKAGE_QT6MQTT
	bool "qt6mqtt"
	help
	  Qt is a cross-platform application and UI framework for
	  developers using C++.

	  This package corresponds to the qt6mqtt module.

	  https://doc.qt.io/qt-6/qtmqtt-index.html
```

## package/qt6/qt6tools/Config.in
```kconfig
config BR2_PACKAGE_QT6TOOLS
	bool "qt6tools"
	select BR2_PACKAGE_QT6BASE_NETWORK
	select BR2_PACKAGE_HOST_QT6BASE_NETWORK
	help
	  Qt is a cross-platform application and UI framework for
	  developers using C++.

	  Qt Tools provides tools facilitate the development
	  and design of applications.

	  https://doc.qt.io/qt-6/qtmodules.html#qt-tools
```

## package/qt6/qt6virtualkeyboard/Config.in
```kconfig
config BR2_PACKAGE_QT6VIRTUALKEYBOARD
	bool "qt6virtualkeyboard"
	help
	  Qt is a cross-platform application and UI framework for
	  developers using C++.

	  This package corresponds to the qt6virtualkeyboard module.

	  https://doc.qt.io/qt-6/qtvirtualkeyboard-index.html
```

## package/qt6/qt6wayland/Config.in
```kconfig
config BR2_PACKAGE_QT6WAYLAND
	bool "qt6wayland"
	help
	  Qt is a cross-platform application and UI framework for
	  developers using C++.

	  This package corresponds to the qt6serialbus module.

	  https://doc.qt.io/qt-6/qtwayland-index.html

#if BR2_PACKAGE_QT6WAYLAND

#config BR2_PACKAGE_QT6DECLARATIVE_QUICK
#	bool "quick module"
#	select BR2_PACKAGE_QT6BASE_GUI
#	select BR2_PACKAGE_QT6LANGUAGESERVER
#	select BR2_PACKAGE_QT6BASE_OPENGL if BR2_PACKAGE_QT5_GL_AVAILABLE
#
#endif
```

## package/qt6/qt6websockets/Config.in
```kconfig
config BR2_PACKAGE_QT6WEBSOCKETS
	bool "qt6websockets"
	help
	  Qt is a cross-platform application and UI framework for
	  developers using C++.

	  This package corresponds to the qt6websockets module.

	  https://doc.qt.io/qt-6/qtwebsockets-index.html
```
