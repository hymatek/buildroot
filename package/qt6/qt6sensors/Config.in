## package/qt6/qt6sensors/Config.in
```kconfig
config BR2_PACKAGE_QT6SENSORS
	bool "qt6sensors"
	help
	  This package provides the Qt Sensors module:

	  https://doc.qt.io/qt-6/qtsensors-index.html
```

## package/qt6/qt6tools/Config.in.host
```kconfig
config BR2_PACKAGE_HOST_QT6TOOLS
	bool "host qt6tools"
	help
	  This package provides Qt6 Tools:

	  https://code.qt.io/cgit/qt/qttools.git

if BR2_PACKAGE_HOST_QT6TOOLS

config BR2_PACKAGE_HOST_QT6TOOLS_LINGUIST_TOOLS
	bool "host linguist tools"
	help
	  Translate Qt C++ and Qt Quick applications into local
	  languages. Includes tools like lupdate, lrelease, and
	  lconvert for managing translation files.

endif
```
